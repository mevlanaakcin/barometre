#include <Adafruit_GFX.h>
#include <Adafruit_SSD1306.h>
Adafruit_SSD1306 display(128, 64, &Wire, -1);
#include <Fonts/FreeSansBold18pt7b.h>
#include <Fonts/FreeSansBold12pt7b.h>
#include <Fonts/FreeSansBold9pt7b.h>
#include <Fonts/TomThumb.h>
#include <Button.h>
#include <avr/sleep.h>

#define sabitle 12    //Hold Anahtar
#define kalibre 10    //Kalibre Buton
Button birim(5);      //Birim değiştirme Buton
#define mBar A1       //mBar basınç sensörü okuma pini
#define batarya A0    //Pil kapasite okuma pini

float b, b1sifir, b2sifir; //basınç değişkenleri
char *basinc_deger[] = {"mBar", "Pa"};
int btip = 0; //0=mBar, 1=Pa, 2=Psi, 3=Bar, 4=MPa
int p = 0;
bool pzayif2 = false, pzayif1 = false;
long bekleme1, bekleme2;
volatile float refvolt = 0.00;

const unsigned char logo [] PROGMEM = {
  // 'atabey128x48', 128x48px
  0x00, 0x00, 0x00, 0x00, 0x00, 0x00, 0x00, 0x00, 0x00, 0x00, 0x00, 0x00, 0x00, 0x00, 0x00, 0x00,
  0x00, 0x00, 0x00, 0x00, 0x00, 0x00, 0x0e, 0x0f, 0x00, 0x00, 0x00, 0x00, 0x00, 0x00, 0x00, 0x00,
  0x00, 0x00, 0x00, 0x00, 0x00, 0x00, 0x1f, 0x9b, 0x00, 0x00, 0x00, 0x00, 0x00, 0x00, 0x00, 0x00,
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  0x00, 0x00, 0x00, 0x00, 0x00, 0x08, 0x80, 0x00, 0x00, 0x00, 0x00, 0x00, 0x00, 0x00, 0x00, 0x00
};

void setup() {
  pinMode(sabitle, INPUT);
  pinMode(kalibre, INPUT);
  birim.begin();
  delay(200);

  display.begin(SSD1306_SWITCHCAPVCC, 0x3C);  //I2C addr 0x3C
  delay(100);

  display.clearDisplay();
  display.setFont();
  display.setTextSize(0);
  display.setTextColor(WHITE);
  display.setCursor(8, 1);
  display.print("www.infotest.com.tr");
  display.drawBitmap(0, 16, logo, 128, 64, WHITE);
  display.display();
  delay(5000);

  readVcc();
  bekleme1 = millis();
  //ilk açılışta otomatik kalibre
  float b1 = analogRead(mBar);
  b1 = (b1 * refvolt) / 1023.00;
  b1sifir = (((b1 / refvolt) - 0.50) / 0.20);
}

void loop() {
  readVcc();
  pil();
  basinc();
  oled_lcd();
  buton();
  delay(40);
}

void oled_lcd() {
  display.clearDisplay();
  if (pzayif2 == false) {
    display.drawRect(2, 0, 5, 2, WHITE);
    display.drawRect(1, 2, 7, 11, WHITE);
    display.fillRect(2, 6, 5, 6, WHITE);
  }
  display.setFont();
  display.setTextSize(1);
  display.setTextColor(WHITE);
  display.setCursor(11, 6);
  display.print("%");
  display.print(p); //Pil değerini ekrana yazdır
  display.setFont(&FreeSansBold9pt7b);
  display.setTextSize(1);
  display.setCursor(65, 13);
  display.print(basinc_deger[btip]);
  display.drawLine(0, 15, 127, 15, WHITE);
  display.setFont(&FreeSansBold18pt7b);
  display.setTextSize(1);
  display.setCursor(0, 54);
  display.print(b, 2); //Basınç değerini ekrana yazdır, virgülden sonra 2 karakter
  display.display();
}

long readVcc() {
  long powvolt = 0;
  for (int i = 0; i < 10; i++) {
    // Read 1.1V reference against AVcc
    // set the reference to Vcc and the measurement to the internal 1.1V reference
#if defined(__AVR_ATmega32U4__) || defined(__AVR_ATmega1280__) || defined(__AVR_ATmega2560__)
    ADMUX = _BV(REFS0) | _BV(MUX4) | _BV(MUX3) | _BV(MUX2) | _BV(MUX1);
#elif defined (__AVR_ATtiny24__) || defined(__AVR_ATtiny44__) || defined(__AVR_ATtiny84__)
    ADMUX = _BV(MUX5) | _BV(MUX0);
#elif defined (__AVR_ATtiny25__) || defined(__AVR_ATtiny45__) || defined(__AVR_ATtiny85__)
    ADMUX = _BV(MUX3) | _BV(MUX2);
#else
    ADMUX = _BV(REFS0) | _BV(MUX3) | _BV(MUX2) | _BV(MUX1);
#endif
    delay(2); // Wait for Vref to settle
    ADCSRA |= _BV(ADSC); // Start conversion
    while (bit_is_set(ADCSRA, ADSC)); // measuring

    uint8_t low  = ADCL; // must read ADCL first - it then locks ADCH
    uint8_t high = ADCH; // unlocks both

    long result = (high << 8) | low;

    powvolt = powvolt + (1125300L / result); // Calculate Vcc (in mV); 1125300 = 1.1*1023*1000
  }
  refvolt = powvolt / 10000.00;
  return refvolt; // Vcc in volts
}

void pil() { //Pil durumunu % olarak gösterir
  int x = 0;
  int xmin = ((2.7 * 1023.00) / refvolt);
  int xmax = ((4.2 * 1023.00) / refvolt);
  for (int i = 0; i < 10; i++)
    x = analogRead(batarya) + x;
  x = map(x / 10, xmin, xmax, 0, 100);
  if (x > p + 1 || x < p - 1)
    p = x;
  p = constrain(p, 0, 100);
  if (p <= 15 && pzayif1 == false) {
    pzayif1 = true;
    pzayif2 = true;
  }
  else if (p <= 0 && pzayif1 == true)
    sistem_kapan();
  else if (pzayif1 == true && pzayif2 == true)
    pzayif2 = false;
  else if (pzayif1 == true && pzayif2 == false)
    pzayif2 = true;
  bekleme2 = millis(); //otomatik kapanma süresi ayarı
  if (bekleme1 < bekleme2 - 180000) //>>>>>>>>>>>>>>>>>>>>>>>>>>>>>>>>>>>>>>60 saniye için 60000
    sistem_kapan();
}

void basinc() { //mBar,Pa,Psi,Bar,MPa cinsinden basın değeri verir
  float b1 = analogRead(mBar);
  b1 = (b1 * refvolt) / 1023.00;
  b1 = (((b1 / refvolt) - 0.50) / 0.20) - b1sifir; //kPaskal
  //if (b1 > 2 || b1 < -2 || b2 > 1.2)
  switch (btip) {
    case 0: //mBar
      b = b1 * 10.00;
      break;
    case 1: //Pa
      b = b1 * 1000;
      break;
  }
  /*if (int(b1) > 0) //otomatik kapanma süresi sıfırlama
    bekleme1 = millis();*/
}

void buton() {
  if (digitalRead(kalibre)) {
    if (btip == 0 || btip == 1) {
      float b1 = analogRead(mBar);
      b1 = (b1 * refvolt) / 1023.00;
      b1sifir = ((b1 / refvolt) - 0.50) / 0.20;
      bekleme1 = millis(); //bekleme süresi sıfırlama
    }
  }
  if (birim.pressed()) {
    btip++;
    bekleme1 = millis(); //bekleme süresi sıfırlama
    if (btip > 1)
      btip = 0;
  }
  while (digitalRead(sabitle) == false) {
    display.fillRect(37, 0, 11, 14, WHITE);
    display.fillRect(39, 2, 2, 10, BLACK);
    display.fillRect(44, 2, 2, 10, BLACK);
    display.fillRect(41, 6, 3, 2, BLACK);
    display.display();
    delay(100);
    bekleme1 = millis(); //bekleme süresi sıfırlama
    pil();
  }
}

void sistem_kapan() {
  delay(100);
  display.clearDisplay();
  display.display();
  set_sleep_mode(SLEEP_MODE_PWR_DOWN);
  sleep_enable();
  sleep_mode();
}
